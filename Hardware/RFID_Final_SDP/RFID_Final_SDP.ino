#include <Wire.h>
#include <SPI.h>
#include <Adafruit_PN532.h>
//^^ inclued libries 
#define PN532_SCK  (13)
#define PN532_MOSI (11)
#define PN532_SS   (10)
#define PN532_MISO (12)
char playerRequest;
int playerRequestInt;
Adafruit_PN532 nfc(PN532_SCK, PN532_MISO, PN532_MOSI, PN532_SS);
uint8_t cards[52][7] = {
{0x04, 0xAD, 0x23, 0x8A, 0x02, 0x6C, 0x84},
{0x04, 0xF4, 0xBF, 0x9A, 0x77, 0x6B, 0x80},
{0x04, 0x82, 0x3C, 0x8A, 0x02, 0x6C, 0x84},
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{0x04, 0x92, 0xB6, 0x9A, 0x77, 0x6B, 0x80},
};

String names[] = {"2C", "AC", "3C", "4C", "5C", "6C", "7C", "8C", "9C", "10C", "JC", "QC", "KC", "AH", "2H", "3H", "4H", "5H", "6H", "7H", "8H", "9H", "10H", "JH", "QH", "KH", "AS", "2S", "3S", "4S", "5S", "6S", "7S", "8S", "9S", "10S", "JS", "QS", "KS", "AD", "2D", "3D", "4D", "5D", "6D", "7D", "8D", "9D", "10D", "JD", "QD", "KD"};
const int Shuffler = 2;


void setup(void) {
  Serial.begin(115200);
  Serial.setTimeout(1);
  while (!Serial) delay(10); // for Leonardo/Micro/Zero
  nfc.begin();
  uint32_t versiondata = nfc.getFirmwareVersion();
  if (! versiondata) {
    Serial.print("error");
    while (1); // halt
  }
  // configure board to read RFID tags
  nfc.SAMConfig();
}


void loop(void) {
  uint8_t success;
  uint8_t uid[] = { 0, 0, 0, 0, 0, 0, 0 };  // Buffer to store the returned UID
  uint8_t uidLength;                        // Length of the UID (4 or 7 bytes depending on ISO14443A card type)
  int i; 
  int j; 
  uint8_t removable_cards[52][7]; 
  // Wait for an ISO14443A type cards (Mifare, etc.).  When one is found
  // 'uid' will be populated with the UID, and uidLength will indicate
  // if the uid is 4 bytes (Mifare Classic) or 7 bytes (Mifare Ultralight)

   if (Serial.available() > 0) {    // is a character available?
      //playerRequest = Serial.read();
      //playerRequestInt = playerRequest - '0'; //gets the int of the char
      int playerRequestByte = Serial.readString().toInt();
        if (playerRequestByte == 0){
          pinMode(Shuffler, OUTPUT);
          digitalWrite(Shuffler, HIGH);
          delay(5000);
          digitalWrite(Shuffler, LOW);
     }if (playerRequestByte == 1){
          success = nfc.readPassiveTargetID(PN532_MIFARE_ISO14443A, uid, &uidLength);
            if (success) {
              delay(200);
              int valid = 0;
              for (j = 0; j < 52; j++){
                for (i = 0; i<7; i++){ 
                  if (uid[i] != cards[j][i]){
                    break;
                  }
                  if (i == 6){
                    Serial.print(names[j]);
                    delay(200);
                    valid = 1;
                  }
                }
              }
              if (valid == 0) {
                Serial.print("Invalid Card");

               }
            }
                
               }
               }
    
     
  }
